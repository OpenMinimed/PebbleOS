## fw/services/minimed/Kconfig
```kconfig
# SPDX-FileCopyrightText: 2026 Morten Fyhn Amundsen
# SPDX-License-Identifier: Apache-2.0

config MINIMED_PREDICTOR
    bool "MiniMed 30-minute glucose forecast"
    depends on MINIMED_SAKE
    default y
    help
      Forecast glucose 30 minutes ahead from the pump's readings, insulin and meals, and send it
      to the watchface. Total IOB does not depend on it.

config MINIMED_HYPO
    bool "MiniMed hypo (treat-or-wait) model"
    depends on MINIMED_PREDICTOR
    default y
    help
      Score a falling low on whether to treat it, show the result on the watchface and pop up an
      alert past the treat threshold. Reads the forecast's 4-hour window. About 20 KB of flash,
      most of it model weights.
```

## fw/services/minimed/stubs/Kconfig
```kconfig
# SPDX-FileCopyrightText: 2026 Pal Marci
# SPDX-License-Identifier: Apache-2.0

config MINIMED_STUB_VOICE
    def_bool y
    depends on MINIMED_SAKE && !SERVICE_VOICE && !SERVICE_VOICE_ENDPOINT
    help
      Link stand-ins for the voice service and the voice endpoint, so a MiniMed build can leave
      voice dictation (and its speex codec) out. Upstream assumes voice is always built: the
      applib dictation window, the process manager, normal-mode service init and the protocol
      endpoint table call into it unconditionally. Dictation then fails like it does without a
      microphone. On by itself whenever a MiniMed build sets CONFIG_SERVICE_VOICE_ENDPOINT=n
      (which also turns SERVICE_VOICE off), since that build cannot link without it. For asterix,
      whose 992 KB flash region cannot hold v4.41.0 and the pump link otherwise.
```
